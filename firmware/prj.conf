## CMakeLists.txt
```
#-------------------------------------------------------------------------------
# Zephyr Example Application
#
# Copyright (c) 2021 Nordic Semiconductor ASA
# SPDX-License-Identifier: Apache-2.0

cmake_minimum_required(VERSION 3.13.1)
find_package(Zephyr REQUIRED HINTS $ENV{ZEPHYR_BASE})

project(app LANGUAGES C VERSION 1.0.0)

configure_file(app_version.h.in ${CMAKE_BINARY_DIR}/app/include/app_version.h)
target_include_directories(app PRIVATE ${CMAKE_BINARY_DIR}/app/include src)

target_sources(app PRIVATE
    src/main.cpp

    src/bt/BLE.cpp
    src/imu/IMU.cpp
    src/imu/IMU_virtual.cpp

    src/term/term.cpp

    src/sys/msg.cpp
)
```

## prj.conf
```kconfig
#######################
#  LANGUAGE SETTINGS  #
#######################
CONFIG_CPLUSPLUS=y
CONFIG_STD_CPP20=y
CONFIG_LIB_CPLUSPLUS=y
CONFIG_NEWLIB_LIBC=y
CONFIG_NEWLIB_LIBC_FLOAT_PRINTF=y
CONFIG_NEWLIB_LIBC_FLOAT_SCANF=y

############
#  KERNEL  #
############

# Incresed stack due to settings API usage
CONFIG_SYSTEM_WORKQUEUE_STACK_SIZE=2048

###############
#  BLUETOOTH  #
###############

CONFIG_BT=y
CONFIG_BT_DEBUG_LOG=y
CONFIG_BT_DEVICE_NAME="P21380;R-HIP"

CONFIG_BT_PERIPHERAL=y
CONFIG_BT_MAX_CONN=2

CONFIG_BT_SMP=y

CONFIG_BT_SIGNING=y
CONFIG_BT_DIS=y
CONFIG_BT_ATT_PREPARE_COUNT=5
CONFIG_BT_BAS=y
CONFIG_BT_HRS=y
CONFIG_BT_PRIVACY=y
CONFIG_BT_DEVICE_APPEARANCE=833
CONFIG_BT_DEVICE_NAME_DYNAMIC=y
CONFIG_BT_DEVICE_NAME_MAX=65

CONFIG_BT_KEYS_OVERWRITE_OLDEST=y
CONFIG_BT_SETTINGS=y
CONFIG_FLASH=y
CONFIG_FLASH_PAGE_LAYOUT=y
CONFIG_FLASH_MAP=y
CONFIG_NVS=y
CONFIG_SETTINGS=y

#CONFIG_BT_RX_BUF_LEN=258
#CONFIG_BT_ATT_TX_MAX=10
#CONFIG_BT_ATT_PREPARE_COUNT=2
#CONFIG_BT_CONN_TX_MAX=10
#CONFIG_BT_L2CAP_TX_BUF_COUNT=10
#CONFIG_BT_L2CAP_TX_MTU=247
#CONFIG_BT_L2CAP_RX_MTU=247
#CONFIG_BT_L2CAP_DYNAMIC_CHANNEL=y
#CONFIG_BT_CTLR_PHY_2M=y
#CONFIG_BT_CTLR_RX_BUFFERS=2
#CONFIG_BT_CTLR_TX_BUFFERS=10
#CONFIG_BT_CTLR_TX_BUFFER_SIZE=251
#CONFIG_BT_CTLR_DATA_LENGTH_MAX=251
#CONFIG_BT_USER_DATA_LEN_UPDATE=y
#CONFIG_BT_USER_PHY_UPDATE=y

# CONFIG_BT_ATT_PREPARE_COUNT=5
# CONFIG_BT_BAS=y
# CONFIG_BT_HRS=y
# CONFIG_BT_PRIVACY=y
# CONFIG_BT_DEVICE_NAME="Zephyr Peripheral Sample Long Name"
# CONFIG_BT_DEVICE_APPEARANCE=833 CONFIG_BT_DEVICE_NAME_DYNAMIC=y
# CONFIG_BT_DEVICE_NAME_MAX=65
# CONFIG_BT_BROADCASTER=y
# CONFIG_BT_OBSERVER=y
# 
# CONFIG_BT_KEYS_OVERWRITE_OLDEST=y
# CONFIG_BT_SETTINGS=y
# CONFIG_FLASH=y
# CONFIG_FLASH_PAGE_LAYOUT=y
# CONFIG_FLASH_MAP=y
# CONFIG_NVS=y
# CONFIG_SETTINGS=y

###########
# for GPIO
###########

CONFIG_GPIO=y

#########
#  SPI  #
#########

CONFIG_SPI=y
#CONFIG_SPI_NRFX=y
#CONFIG_SPI_0=y
#CONFIG_SPI_0_NRF_SPI=y
CONFIG_SENSOR=y

CONFIG_ICM42688=y
CONFIG_ICM42688_TRIGGER_OWN_THREAD=y
CONFIG_ICM42688_TRIGGER_GLOBAL_THREAD=n

#CONFIG_ICM42688_THREAD_PRIORITY=10
#CONFIG_ICM42688_THREAD_STACK_SIZE=2048

#CONFIG_SPI=y
#CONFIG_SENSOR=y
#CONFIG_ICM42688=y
#CONFIG_ICM42688_TRIGGER_OWN_THREAD=y
#CONFIG_ICM42688_THREAD_STACK_SIZE=1024

CONFIG_MEM_SLAB_TRACE_MAX_UTILIZATION=y
#CONFIG_NUM_PREEMPT_PRIORITIES=10

#CONFIG_SYS_CLOCK_TICKS_PER_SEC=333

###########
#  DEBUG  #
###########

# enable RTT
#CONFIG_USE_SEGGER_RTT=y

CONFIG_SHELL=y
#CONFIG_SHELL_BACKEND_RTT=y
CONFIG_SHELL_LOG_BACKEND=y

# enable console
CONFIG_CONSOLE=y
#
# enable uart driver
CONFIG_SERIAL=y
CONFIG_LOG=y

CONFIG_ASSERT=n
```

## rtt.conf
```kconfig
# Copyright (c) 2021 Nordic Semiconductor ASA
# SPDX-License-Identifier: Apache-2.0
#
# This is a Kconfig fragment which can be used to enable Segger RTT options.
# It should be used in conjunction with debug.conf.

# segger RTT console
CONFIG_USE_SEGGER_RTT=y
CONFIG_RTT_CONSOLE=y
CONFIG_SHELL_BACKEND_RTT=y
```

## src/main.c
```c
/*
 * Copyright (c) 2020 TDK Invensense
 *
 * SPDX-License-Identifier: Apache-2.0
 */

#include <device.h>
#include <drivers/gpio.h>
#include <drivers/sensor.h>
#include <drivers/spi.h>
#include <stdio.h>
#include <zephyr.h>

//#define IMU0_NODE DT_ALIAS(invensense,icm42688)
/* #if DT_NODE_HAS_STATUS(IMU0_NODE, okay) */
/* #define IMU0    DT_LABEL(DT_INST(0, icm42688)) */
/* #else */
/* A build error here means your board isn't set up to blink an LED. */
/* #error "Unsupported board: icm42688 devicetree alias is not defined" */
/* #define IMU0 "" */
/* #endif */

#define LED0_NODE DT_ALIAS(led0)

#if DT_NODE_HAS_STATUS(LED0_NODE, okay)
#define LED0 DT_GPIO_LABEL(LED0_NODE, gpios)
#define PIN DT_GPIO_PIN(LED0_NODE, gpios)
#define FLAGS DT_GPIO_FLAGS(LED0_NODE, gpios)
#else
/* A build error here means your board isn't set up to blink an LED. */
#error "Unsupported board: led0 devicetree alias is not defined"
#define LED0 ""
#define PIN 0
#define FLAGS 0
#endif

static const char *now_str(void) {
  static char buf[16]; /* ...HH:MM:SS.MMM */
  uint32_t now = k_uptime_get_32();
  unsigned int ms = now % MSEC_PER_SEC;
  unsigned int s;
  unsigned int min;
  unsigned int h;

  now /= MSEC_PER_SEC;
  s = now % 60U;
  now /= 60U;
  min = now % 60U;
  now /= 60U;
  h = now;

  snprintf(buf, sizeof(buf), "%u:%02u:%02u.%03u", h, min, s, ms);
  return buf;
}

static int process_icm42688(const struct device *dev) {
  struct sensor_value temperature;
  struct sensor_value accel[3];
  struct sensor_value gyro[3];
  int rc = sensor_sample_fetch(dev);

  if (rc == 0) {
    rc = sensor_channel_get(dev, SENSOR_CHAN_ACCEL_XYZ, accel);
  }
  if (rc == 0) {
    rc = sensor_channel_get(dev, SENSOR_CHAN_GYRO_XYZ, gyro);
  }
  if (rc == 0) {
    rc = sensor_channel_get(dev, SENSOR_CHAN_DIE_TEMP, &temperature);
  }
  if (rc == 0) {
    printf("[%s]:% g Cel\n"
           "  accel % f % f % f m/s/s\n"
           "  gyro  % f % f % f rad/s\n",
           now_str(), sensor_value_to_double(&temperature),
           sensor_value_to_double(&accel[0]), sensor_value_to_double(&accel[1]),
           sensor_value_to_double(&accel[2]), sensor_value_to_double(&gyro[0]),
           sensor_value_to_double(&gyro[1]), sensor_value_to_double(&gyro[2]));
  } else {
    printf("sample fetch/get failed: %d\n", rc);
  }

  return rc;
}

static struct sensor_trigger data_trigger;
static struct sensor_trigger tap_trigger;
static struct sensor_trigger double_tap_trigger;

static void handle_icm42688_drdy(const struct device *dev,
                                 struct sensor_trigger *trig) {
  int rc = process_icm42688(dev);

  if (rc != 0) {
    printf("cancelling trigger due to failure: %d\n", rc);
    (void)sensor_trigger_set(dev, trig, NULL);
    return;
  }
}

static void handle_icm42688_tap(const struct device *dev,
                                struct sensor_trigger *trig) {
  printf("Tap Detected!\n");
}

static void handle_icm42688_double_tap(const struct device *dev,
                                       struct sensor_trigger *trig) {
  printf("Double Tap detected!\n");
}

void main(void) {
  printk("Starting IMU Demo...\r\n");

  const char *const label = DT_LABEL(DT_INST(0, invensense_icm42688));
  const struct device *icm42688 = device_get_binding(label);
  const struct device *led = device_get_binding(LED0);

  if (led == NULL) {
    printk("Failed to initialize diagnostic LED");
    return;
  }

  int ret = gpio_pin_configure(led, PIN, GPIO_OUTPUT_ACTIVE | FLAGS);
  if (ret < 0) {
    printk("Could not configure LED");
    return;
  }

  if (!icm42688) {
    printf("Failed to find sensor %s\n", "ICM42688");
    return;
  }

  tap_trigger = (struct sensor_trigger){
      .type = SENSOR_TRIG_TAP,
      .chan = SENSOR_CHAN_ALL,
  };

  if (sensor_trigger_set(icm42688, &tap_trigger, handle_icm42688_tap) < 0) {
    printf("Cannot configure tap trigger!!!\n");
    return;
  }

  double_tap_trigger = (struct sensor_trigger){
      .type = SENSOR_TRIG_DOUBLE_TAP,
      .chan = SENSOR_CHAN_ALL,
  };

  if (sensor_trigger_set(icm42688, &double_tap_trigger,
                         handle_icm42688_double_tap) < 0) {
    printf("Cannot configure double tap trigger!!!\n");
    return;
  }

  data_trigger = (struct sensor_trigger){
      .type = SENSOR_TRIG_DATA_READY,
      .chan = SENSOR_CHAN_ALL,
  };

  if (sensor_trigger_set(icm42688, &data_trigger, handle_icm42688_drdy) < 0) {
    printf("Cannot configure data trigger!!!\n");
    return;
  }

  printf("Configured for triggered sampling.\n");

  while (0) {
    printk("LED On...\n");
    gpio_pin_set(led, PIN, false);
    k_msleep(500);
    printk("LED Off...\n");
    gpio_pin_set(led, PIN, true);
    k_msleep(500);
  }


  return;
}
```

## src/main.cpp
```c
#include <device.h>
#include <drivers/gpio.h>
#include <drivers/sensor.h>
#include <drivers/spi.h>
#include <zephyr.h>
#include <zephyr/types.h>
#include <kernel.h>

#include <bt/BLE.hpp>
#include <imu/IMU.hpp>
#include <term/term.hpp>
#include <sys/msg.hpp>

#include <lib/static_queue.h>

#include <stdio.h>
#include <cstring>
#include <queue>

/**
 * TODO: remove global variables
 * TODO: change IMU callbacks to class
 * TODO: change BLE callbacks to class
 */

/*******************************************************************************
*                       GLOBALS (EWWWWWWWW MUST REMOVE)                       *
*******************************************************************************/

static_queue<IMU::imu_data, 512> imuData; /**< IMU data storage queue. */

/* Debug state modification */
bool running = true;    /**< Whether or not IMU data is recorded */
bool streaming = false; /**< Print IMU recording to shell */

/*******************************************************************************
*                                BT CALLBACKS                                 *
*******************************************************************************/

/**
 * Current BLE state
 */
enum BLE_State_t {
    SEND_SIZE,
    SEND_PACKET,
    SEND_EMPTY,
} ble_state;

uint32_t ble_size; /**< How many IMU packets are available to send */

/**
 * Function to send data to master.
 *
 * @param[in] conn current BLE connection
 * @param[in] attr BLE attribute being written to
 * @param[out] buf the buffer to write data to
 * @param[in] len how many bytes the master requested
 * @param[in] offset data offset in 'buf'
 *
 * @return How many bytes were written to the master
 */
ssize_t imu_data_send(struct bt_conn *conn, const struct bt_gatt_attr *attr,
                    void *buf, uint16_t len, uint8_t offset)
{
    ssize_t sz;

    switch (ble_state) {
    case SEND_SIZE:
        ble_size = imuData.size();

        sz = bt_gatt_attr_read(conn, attr, buf, len, offset,
                               (void*)&ble_size, sizeof(ble_size));

        
        if (ble_size)
            ble_state = SEND_PACKET;
        else
            ble_state = SEND_EMPTY;
        break;
    case SEND_PACKET:
        if (ble_size) {
            IMU::imu_data data = imuData.front();
            sz = bt_gatt_attr_read(conn, attr, buf, len, offset,
                                   (void*)&data, sizeof(data));
            if (!--ble_size)
                ble_state = SEND_EMPTY;
            break;
        }
    case SEND_EMPTY:
    default:
        sz =  bt_gatt_attr_read(conn, attr, buf, len, offset, 0, 1);
    }

    return sz;
}

/**
 * BLE connection callback
 *
 * @param[in] conn current BLE connection
 * @param[in] err to propagate, currently not handled
 */
void ble_connect(struct bt_conn* conn, uint8_t err)
{
    ble_state = SEND_SIZE;
}

/**
 * BLE disconnect callback
 *
 * @param[in] conn current BLE connection
 * @param[in] err to propagate, currently not handled
 */
void ble_disconnect(struct bt_conn* conn, uint8_t reason)
{
    ble_state = SEND_SIZE;
}

// BLE callbacks
BLE::Callback_t BLE_Callbacks = {
    .send       = imu_data_send,
    .recv       = nullptr,
    .connect    = ble_connect,
    .disconnect = ble_disconnect
};

/*******************************************************************************
*                                IMU FUNCTIONS                                *
*******************************************************************************/

/**
 * Called whenever IMU data is recorded.
 *
 * @param[in] imu The data that was recorded.
 */
void imu_callback(IMU::imu_data* imu)
{
    if (streaming)
        imu->print();

    if (!running) return; // Only do this stuff if the data is running

    imuData.push(*imu);

    BLE::setAdData(imuData.size());
}

/**
 * Empties IMU queue and prints all data to shell.
 * @warning should only be used in debug mode
 */
void imu_dump_to_term(void)
{
    bool full = (imuData.size() == imuData.max_size());

    while(imuData.size()) {
        IMU::imu_data f = imuData.front();
        imuData.pop();

        f.print();
    }

    if (full)
        printk("WARNING: IMU Data queue was full, "
               "meaning some data points were lost.");

}


/*******************************************************************************
*                                STATE MACHINE                                *
*******************************************************************************/

/**
 * Main state machine.
 *
 * Looped forever. As of now this is only used for debug state selection.
 */
void stateMachine(void)
{
    sys::msg::MsgData msg = sys::msg::receive();

    switch(msg.tag) {
    case sys::msg::SENSOR_CAPTURE_START:
        running = true;
        break;
    case sys::msg::SENSOR_CAPTURE_STOP:
        running = false;
        imu_dump_to_term();
        break;
    case sys::msg::SENSOR_CAPTURE_STREAM:
        streaming = !streaming;
        break;
    case sys::msg::TIME_SYNC:
        break;
    case sys::msg::NO_MESSAGE:
    default:;
    }
}

/*******************************************************************************
*                                    MAIN                                     *
*******************************************************************************/

/**
 * main.
 * Firmware entry point.
 */
void main(void)
{
    BLE::init(&BLE_Callbacks); // Initialize the BLE system

    #if defined(invensense_icm42688)
        // Hardware IMU
        IMU::init(DT_LABEL(DT_INST(0, invensense_icm42688)), imu_callback);
    #else
        // Software IMU
        IMU::init(nullptr, imu_callback);
    #endif

    /* Manage the main loop state */
    while (1) {
        stateMachine();
        k_sleep(K_SECONDS(1));
    }
}
```
