## boards/arm/nrf52832_imu/Kconfig.board
```kconfig
# nRF52832-IMU board configuration

# Copyright (c) 2018 makerdiary.com.
# SPDX-License-Identifier: Apache-2.0

config BOARD_NRF52832_IMU
	bool "nRF52832-IMU"
	depends on SOC_NRF52832_QFAA
```

## boards/arm/nrf52832_imu/nrf52832_imu_defconfig
```kconfig
# SPDX-License-Identifier: Apache-2.0

CONFIG_SOC_SERIES_NRF52X=y
CONFIG_SOC_NRF52832_QFAA=y
CONFIG_BOARD_NRF52832_IMU=y

# Enable MPU
CONFIG_ARM_MPU=y
CONFIG_HW_STACK_PROTECTION=y

# enable console
#CONFIG_CONSOLE=y
CONFIG_UART_CONSOLE=n

# additional board options
CONFIG_GPIO_AS_PINRESET=y

CONFIG_CLOCK_CONTROL_NRF_K32SRC_RC=n
CONFIG_CLOCK_CONTROL_NRF_K32SRC_XTAL=n
CONFIG_CLOCK_CONTROL_NRF_K32SRC_SYNTH=y
```

## drivers/sensor/Kconfig
```kconfig
# Copyright (c) 2021 Nordic Semiconductor ASA
# SPDX-License-Identifier: Apache-2.0

if SENSOR
rsource "icm42688/Kconfig"
endif # SENSOR
```

## drivers/sensor/icm42688/Kconfig
```kconfig
# ICM42688 Six-Axis Motion Tracking device configuration options

# Copyright (c) 2020 TDK Invensense
# SPDX-License-Identifier: Apache-2.0

menuconfig ICM42688
	bool "ICM42688 Six-Axis Motion Tracking Device"
	depends on SPI
	help
	  Enable driver for ICM42688 SPI-based six-axis motion tracking device.

if ICM42688

choice
	prompt "Trigger mode"
	default ICM42688_TRIGGER_GLOBAL_THREAD
	help
	  Specify the type of triggering to be used by the driver.

config ICM42688_TRIGGER_NONE
	bool "No trigger"

config ICM42688_TRIGGER_GLOBAL_THREAD
	bool "Use global thread"
	depends on GPIO
	select ICM42688_TRIGGER

config ICM42688_TRIGGER_OWN_THREAD
	bool "Use own thread"
	depends on GPIO
	select ICM42688_TRIGGER


endchoice

config ICM42688_TRIGGER
	bool

config ICM42688_THREAD_PRIORITY
	int "Thread priority"
	depends on ICM42688_TRIGGER_OWN_THREAD
	default 10
	help
	  Priority of thread used by the driver to handle interrupts.

config ICM42688_THREAD_STACK_SIZE
	int "Thread stack size"
	depends on ICM42688_TRIGGER_OWN_THREAD
	default 1024
	help
	  Stack size of thread used by the driver to handle interrupts.

endif # ICM42688
```

## zephyr/boards/arm/nrf52832_imu/Kconfig.defconfig
```kconfig
# nRF52832-IMU board configuration

# Copyright (c) 2018 makerdiary.com.
# SPDX-License-Identifier: Apache-2.0

if BOARD_NRF52832_IMU

config BOARD
	default "nrf52832_imu"

config BT_CTLR
	default BT

endif # BOARD_NRF52832_IMU
```

## zephyr/boards/arm/nrf52832_imu/nrf52832_imu_defconfig
```kconfig
# SPDX-License-Identifier: Apache-2.0

CONFIG_SOC_SERIES_NRF52X=y
CONFIG_SOC_NRF52832_QFAA=y
CONFIG_BOARD_NRF52832_IMU=y

# Enable MPU
CONFIG_ARM_MPU=y

# enable uart driver
CONFIG_SERIAL=y

# enable console
CONFIG_CONSOLE=y
CONFIG_UART_CONSOLE=n

CONFIG_SHELL=y
CONFIG_SHELL_BACKEND_RTT=y
CONFIG_SHELL_LOG_BACKEND=n

# additional board options
CONFIG_GPIO_AS_PINRESET=y

# enable RTT
CONFIG_USE_SEGGER_RTT=y

CONFIG_CLOCK_CONTROL_NRF_K32SRC_RC=n
CONFIG_CLOCK_CONTROL_NRF_K32SRC_XTAL=n
CONFIG_CLOCK_CONTROL_NRF_K32SRC_SYNTH=y
```
